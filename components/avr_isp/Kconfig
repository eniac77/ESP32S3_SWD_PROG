## components/avr_isp/Kconfig
```kconfig
menu "AVR ISP programozo"
    config AVR_ISP_SCK_GPIO
        int "SCK GPIO"
        default 15
        help
            Serial clock kimenet az ISP-hez. Idle alacsony (SPI mode 0).
    config AVR_ISP_MOSI_GPIO
        int "MOSI GPIO"
        default 16
        help
            Master Out / Slave In adatkimenet a celhez.
    config AVR_ISP_MISO_GPIO
        int "MISO GPIO"
        default 7
        help
            Master In / Slave Out adatbemenet a celtol.
    config AVR_ISP_RESET_GPIO
        int "RESET GPIO (aktiv alacsony)"
        default 21
        help
            A cel RESET laba. Programozas alatt lehuzva (aktiv alacsony).
endmenu
```

## components/avr_pdi/Kconfig
```kconfig
menu "AVR PDI programozo"
    config AVR_PDI_ENABLE
        bool "PDI interfesz engedelyezese"
        default n
        help
            XMEGA (ATxmega) programozasa PDI ket-vezetekes interfeszen. Default KI:
            a main csak akkor hozza fel (avr_pdi_init), ha be van kapcsolva.
            FIGYELEM: a PDI_DATA (default GPIO7) es PDI_CLK (default GPIO21) labak
            megegyeznek az ISP MISO/RESET es az UPDI labbal — ezert PDI-t es UPDI-t
            NE kapcsold be egyszerre (ugyanazt a GPIO7-et hasznaljak). HW-n MEG NEM
            IGAZOLT.

    config AVR_PDI_CLK_GPIO
        int "PDI_CLK GPIO (= target RESET)"
        default 21
        help
            A PDI orajel; a meglevo programozo-header RESET-vonala (GPIO21).

    config AVR_PDI_DATA_GPIO
        int "PDI_DATA GPIO (ketiranyu)"
        default 7
        help
            A PDI ketiranyu adatvonala; a header MISO-labja (GPIO7).
endmenu
```

## components/avr_tpi/Kconfig
```kconfig
menu "AVR TPI programozo"
    config AVR_TPI_ENABLE
        bool "TPI interfesz engedelyezese"
        default n
        help
            Reduced-core ATtiny (ATtiny4/5/9/10/20/40/102/104) programozasa TPI
            harom-vezetekes interfeszen. Default KI: a main csak akkor hozza fel
            (avr_tpi_init), ha be van kapcsolva.
            FIGYELEM: a TPICLK (default GPIO15=SCK), TPIDATA (GPIO7=MISO) es RESET
            (GPIO21) labak megegyeznek az ISP/PDI/UPDI labakkal -> egyszerre csak
            egy AVR-interfeszt kapcsolj be. HW-n MEG NEM IGAZOLT.

    config AVR_TPI_CLK_GPIO
        int "TPICLK GPIO"
        default 15
        help
            A TPI orajel; a meglevo programozo-header SCK-vonala (GPIO15).

    config AVR_TPI_DATA_GPIO
        int "TPIDATA GPIO (ketiranyu)"
        default 7
        help
            A TPI ketiranyu adatvonala; a header MISO-labja (GPIO7).

    config AVR_TPI_RESET_GPIO
        int "TPI RESET GPIO (aktiv alacsony)"
        default 21
        help
            A cel RESET laba; a TPI alatt alacsonyan tartva.
endmenu
```

## components/avr_updi/Kconfig
```kconfig
menu "AVR UPDI programozo"
    config AVR_UPDI_ENABLE
        bool "UPDI interfesz engedelyezese"
        default n
        help
            Modern tinyAVR/megaAVR 0/1/2-series (es kesobb AVR Dx) programozasa
            UPDI single-wire interfeszen. Default KI: a main csak akkor hozza fel
            (avr_updi_init), ha be van kapcsolva, igy nincs UART2-foglalas felesleg.
            HW-n MEG NEM IGAZOLT.

    config AVR_UPDI_GPIO
        int "UPDI GPIO (single-wire)"
        default 7
        help
            A UPDI 1-vezetekes vonala. Default a meglevo programozo-header MISO
            labja (GPIO7). Open-drain + ~4,7k soros ellenallas ajanlott a celhez.

    config AVR_UPDI_BAUD
        int "UPDI baud"
        default 115200
        help
            UPDI UART sebesseg (8E2). A UPDI alap-oszcillatornal 115200 biztonsagos;
            feljebb a cel UPDICLK-jatol fugg.
endmenu
```

## components/cortexm_debug/Kconfig
```kconfig
menu "Cortex-M debug"
    config CORTEXM_HW_NRST
        bool "Hardveres nRST hasznalata a csatlakozashoz (ha be van kotve a celhez)"
        default n
        help
            Ha a cel-csatlakozon a nRST MEGIS elerheto, ez bekapcsolja a
            klasszikus connect-under-reset-et (nRST assert alatt bring-up,
            majd release). Alapertelmezetten KIKAPCSOLVA: a cel aramkorokon
            az nRST tipikusan nem elerheto, ezert tisztan SWD-n (SYSRESETREQ
            + vektor-catch) csatlakozunk.
endmenu
```

## components/storage_usb/Kconfig
```kconfig
menu "USB MSC host (pendrive forras)"

    config USB_MSC_HOST_ENABLE
        bool "USB MSC host engedelyezese (pendrive-rol toltes)"
        default n
        help
            Bekapcsolva a GPIO19/20 native USB pad OTG host modba kerul, es a
            bedugott USB stick (MSC, FAT32) a /usb ala mountolodik. Ha van stick,
            a firmware/config lista a stickrol jon (a belso LittleFS helyett).

            FONTOS: a native USB pad megosztott, ezert a masodlagos
            USB-Serial/JTAG konzolt KI kell kapcsolni
            (CONFIG_ESP_CONSOLE_SECONDARY_NONE=y). Az elsodleges konzol UART0-n
            marad; a flasheles/monitorozas ekkor kulso USB-UART-rol megy
            (GPIO43/44). Kikapcsolva (default) semmi nem valtozik.

    config USB_MSC_HOST_VBUS_GPIO
        int "VBUS EN GPIO (load-switch / boost; -1 = nincs)"
        depends on USB_MSC_HOST_ENABLE
        range -1 48
        default -1
        help
            Ha a panelen kulon 5 V VBUS load-switch vagy boost EN labja van,
            add meg a GPIO szamat — init-kor magasra huzzuk (a stick tapja).
            -1 eseten nem vezerlunk VBUS-t (mindig taplalt vagy nem szukseges).

endmenu
```

## main/Kconfig.projbuild
```kconfig
menu "Bring-up es naplozas"

    config BRINGUP_SELFTEST
        bool "Boot-idoi SWD onteszt (cel detektalas + napló)"
        default y
        help
            Boot utan egyszer megprobal SWD-n csatlakozni a celhoz, es az
            UART-konzolra kiirja a DPIDR/DEV_ID/flash meret/RDP adatokat.
            Bench bring-uphoz hasznos. Cel nelkul csak egy figyelmezteto sort ad.

    config BRINGUP_SELFTEST_PERIODIC
        bool "Periodikus ujra-detektalas a fociklusban"
        depends on BRINGUP_SELFTEST
        default n
        help
            Ha be van kapcsolva, a fociklus periodikusan ujra lefuttatja az
            ontesztet (a heartbeat helyett).

    config BRINGUP_SELFTEST_PERIOD_S
        int "Periodikus onteszt periodusa (s)"
        depends on BRINGUP_SELFTEST_PERIODIC
        range 2 3600
        default 5

    config BRINGUP_AVR_SELFTEST
        bool "Boot-idoi AVR ISP onteszt (signature olvasas + napló)"
        default n
        help
            Boot utan egyszer megprobalja AVR ISP-n kiolvasni a cel signature-t
            (ATtiny13 stb.), es az UART-konzolra irja. Default KI (a SWD onteszt
            mas labakon van; csak akkor kapcsold be, ha AVR cel van bekotve).

endmenu
```

## sdkconfig.defaults
```kconfig
# --- Cél: ESP32-S3-N16R8 (16 MB flash, 8 MB octal PSRAM) ---
CONFIG_IDF_TARGET="esp32s3"

# Flash méret
CONFIG_ESPTOOLPY_FLASHSIZE_16MB=y

# Octal PSRAM (R8) — kötelező R8 modulhoz
CONFIG_SPIRAM=y
CONFIG_SPIRAM_MODE_OCT=y
CONFIG_SPIRAM_SPEED_80M=y
CONFIG_SPIRAM_USE_MALLOC=y

# Egyedi partíciós tábla
CONFIG_PARTITION_TABLE_CUSTOM=y
CONFIG_PARTITION_TABLE_CUSTOM_FILENAME="partitions.csv"

# FreeRTOS tick: 1 ms (UI/serial időzítéshez kényelmes)
CONFIG_FREERTOS_HZ=1000

# HTTP szerver WebSocket támogatás (web_ui /ws élő adat + progress)
CONFIG_HTTPD_WS_SUPPORT=y

# Naplózás: VERBOSE szint befordítva, alap szint DEBUG (a SWD/FLM tag-ek
# VERBOSE-ra emelve futásidőben a main-ben). Teljes UART-konzol napló.
CONFIG_LOG_DEFAULT_LEVEL_DEBUG=y
CONFIG_LOG_MAXIMUM_LEVEL_VERBOSE=y
```
